## boards/measlesbagel/bridges_v2/board.yml
```yaml
boards:
  - name: bridges_v2_left
    vendor: measlesbagel
    socs:
      - name: nrf52840
  - name: bridges_v2_right
    vendor: measlesbagel
    socs:
      - name: nrf52840
```

## boards/shields/bridges_v2_dongle/Kconfig.defconfig
```kconfig
# Copyright (c) 2026 Vincent Franco
# SPDX-License-Identifier: MIT

if SHIELD_BRIDGES_V2_DONGLE

config ZMK_KEYBOARD_NAME
    default "Bridges V2"

config ZMK_SPLIT
    default y

config ZMK_SPLIT_ROLE_CENTRAL
    default y

# Both halves connect to the dongle.
config ZMK_SPLIT_BLE_CENTRAL_PERIPHERALS
    default 2

config ZMK_POINTING
    default y

endif # SHIELD_BRIDGES_V2_DONGLE
```

## boards/shields/bridges_v2_dongle/Kconfig.shield
```kconfig
# Copyright (c) 2026 Vincent Franco
# SPDX-License-Identifier: MIT

config SHIELD_BRIDGES_V2_DONGLE
    def_bool $(shields_list_contains,bridges_v2_dongle)
```

## config/west.yml
```yaml
manifest:
  defaults:
    revision: main
  remotes:
    - name: zmkfirmware
      url-base: https://github.com/zmkfirmware
    - name: black-trooper
      url-base: https://github.com/black-trooper
  projects:
    - name: zmk
      remote: zmkfirmware
      import: app/west.yml
    - name: zmk-driver-paw3222
      remote: black-trooper
      revision: main
  self:
    path: config
```
