/*
 * Copyright (c) 2026 Vincent Franco
 * SPDX-License-Identifier: MIT
 *
 * The left half as split central: its own ball is read locally, the
 * right ball arrives on the right split channel.
 */

&trackball_right_split {
    status = "okay";
};

&trackball_left_listener {
    status = "okay";
    device = <&trackball_left>;
};

&trackball_right_listener {
    status = "okay";
};

&config_acm {
    status = "okay";
};
